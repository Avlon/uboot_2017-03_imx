## board/seco/mx6qdl_a62/Kconfig
```kconfig
if TARGET_SECO_A62_MX6QDL

config SYS_BOARD
	default "mx6qdl_a62"

config SYS_CONFIG_NAME
	default "seco_imx6qdl_a62_android"

endif
```

## board/seco/mx6qdl_c04/Kconfig
```kconfig
if TARGET_SECO_C04_MX6QDL

config SYS_BOARD
	default "mx6qdl_c04"

config SYS_CONFIG_NAME
	default "seco_imx6qdl_c04_android"

endif
```

## board/seco/mx6sdl_uq7/Kconfig
```kconfig
if TARGET_SECO_uQ7_MX6DL

config SYS_BOARD
	default "mx6sdl_uq7"

config SYS_CONFIG_NAME
	default "seco_imx6sdl_uq7_android"

endif
```

## board/seco/mx6sx_b08/Kconfig
```kconfig
if TARGET_SECO_B08

config SYS_BOARD
	default "mx6sx_b08"

config SYS_CONFIG_NAME
	default "seco_imx6sx_b08_android"

endif
```

## configs/secomx6q_a62_android_defconfig
```kconfig
CONFIG_SPL=y
CONFIG_ARM=y
CONFIG_ARCH_MX6=y
CONFIG_TARGET_SECOBOARD=y
CONFIG_TARGET_SECO_A62_MX6QDL=y
CONFIG_SYS_EXTRA_OPTIONS="IMX_CONFIG=arch/arm/imx-common/spl_sd.cfg,ANDROID_SUPPORT,MX6Q"
CONFIG_DM=y
CONFIG_DM_THERMAL=y
CONFIG_SYS_MMCSD_RAW_MODE_U_BOOT_USE_SECTOR=y
CONFIG_SYS_MMCSD_RAW_MODE_U_BOOT_SECTOR=0x8a
CONFIG_EFI_PARTITION=y
CONFIG_CMD_MMC=y
CONFIG_CMD_USB=y
CONFIG_CMD_SF=y
CONFIG_OF_LIBFDT=y
CONFIG_HUSH_PARSER=y
CONFIG_SPL_WATCHDOG_SUPPORT=y
CONFIG_CMD_SECO_CONFIG=n
```

## drivers/watchdog/Kconfig
```kconfig
menu "WATCHDOG support"

config ULP_WATCHDOG
	bool "i.MX7ULP watchdog"
	help
	  Say Y here to enable i.MX7ULP watchdog driver.

config APX_WATCHDOG
	bool "APX watchdog"
	help
	  Say Y here to enable APX watchdog driver.

endmenu
```
